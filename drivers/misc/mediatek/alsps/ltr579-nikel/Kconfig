## drivers/misc/mediatek/alsps/ltr579-nikel/Kconfig
```kconfig
config MTK_LTR579
	bool "ltr579 ALS/PS for MediaTek package"
	default n
	help
	  Support for the Lite-On LTR-579ALS-01 ambient light and
	  proximity sensor found on the Xiaomi Redmi Note 4 (nikel).
```

## drivers/misc/mediatek/gyroscope/bmi120gy-new/Kconfig
```kconfig
config MTK_BMI160_GYRO
	bool "MTK_BMI160 gyroscope for MediaTek package"
	default n
	help
	  Support the gyroscope half of the Bosch BMI160 IMU used on
	  some MediaTek boards.  The accelerometer half is provided by
	  MTK_BMI160_ACC; both share the same i2c client.
```

## drivers/misc/mediatek/magnetometer/yamaha537/Kconfig
```kconfig
config MTK_YAS537
	bool "YAS537 for Mediatek package"
	default n
	help
	  It supports the Yamaha YAS537 magnetometer.
	  If this option is set, the kernel will build the YAS537
	  magnetometer driver used on MT6797 devices.
```
